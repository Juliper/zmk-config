## config/west.yml
```yaml
manifest:
  remotes:
    - name: zmkfirmware
      url-base: https://github.com/zmkfirmware
    - name: duckyb
      url-base: https://github.com/duckyb
  projects:
    - name: zmk
      remote: duckyb          # <-- duckyb's Fork, NICHT zmkfirmware!
      revision: main
      import: app/west.yml
  self:
    path: config
```
